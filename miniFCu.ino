#include <SPI.h>
#include <Wire.h>
#include <Adafruit_GFX.h>
#include "Fonts/muHeavy8ptBold.h"
#include <Adafruit_SSD1306.h>
#include <ESP8266WiFi.h>
#include <ESP8266HTTPClient.h>
#include "ArduinoJson.h"

Adafruit_SSD1306 display(128, 64, &Wire, -1);
JsonDocument doc;


//About
String setSSID = "Familia-2.4G";
String setPassword = "familia123";
String serverLink = "";
int encreaseValue = 5;
int debounceEncoder = 50;
bool isConnected = false;
bool isSleeping = false;

//Important
long lastMillis;
volatile int cursor = 0;
volatile int encoderValue = 0;
enum Screens {mixer, outputDevice, flightSim, sleep, config};

//Encoder
int CLK = 2;
int DT = 0;
int BTN = 16;
bool encoderIsValue = false; // False -> Cursor | True -> value

//Shift Register
int shiftRegisterDataPin = 14;
int shiftRegisterClockPin = 12;
int shiftRegisterSendPin = 13;

void IRAM_ATTR rotaryEncoderCLK(){
  int data = digitalRead(DT);

  if(millis() - lastMillis > debounceEncoder){
    //Sair do modo Sleep:
    isSleeping = false; 

    if(data == 1){

      switch (encoderIsValue) {
      case false: 
        cursor--; 
        break;
      case true:
        encoderValue = encoderValue - encreaseValue;
      }    
    } else {

      switch (encoderIsValue) {
      case false: 
        cursor++; 
        break;
      case true:
        encoderValue = encoderValue + encreaseValue;
      } 
    }
    
    lastMillis = millis();
  }
}

void IRAM_ATTR rotaryEncoderDT(){
  int clk = digitalRead(CLK);

  if(millis() - lastMillis > 50){
    //Sair do modo Sleep:
    isSleeping = false;

    if(clk == 0){

      switch (encoderIsValue) {
      case false: 
        cursor--; 
        break;
      case true:
        encoderValue = encoderValue - encreaseValue;
      }    
    } else {

      switch (encoderIsValue) {
      case false: 
        cursor++; 
        break;
      case true:
        encoderValue = encoderValue + encreaseValue;
      } 
    }
    
    lastMillis = millis();
  }
}


// Draws
  const unsigned char PROGMEM icon_speaker_device_20_20 [] = {0x00, 0x00, 0x00, 0x07, 0xfe, 0x00, 0x08, 0x01, 0x00, 0x08, 0xf1, 0x00, 0x09,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 0x00, 0x00};
  const unsigned char PROGMEM icon_volume_20_20 []  = {0x00, 0x00, 0x00, 0x00, 0x00, 0x00, 0x00, 0xe0, 0x00, 0x01, 0x21, 0x00, 0x02,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 0x00, 0x00};
  const unsigned char PROGMEM icon_plane_20_20 [] = {0x00, 0x00, 0x00, 0x00, 0x00, 0x00, 0x00, 0x01, 0xc0, 0x1c, 0x02, 0x40, 0x23,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 0x00, 0x00};
  const unsigned char PROGMEM icon_wifi_not_connected_19_16[] = {0x21,0xf0,0x00,0x16,0x0c,0x00,0x08,0x03,0x00,0x25,0xf0,0x80,0x42,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0x00,0x00};
  const unsigned char PROGMEM icon_wifi_full_19_16[] = {0x01,0xf0,0x00,0x07,0xfc,0x00,0x1e,0x0f,0x00,0x39,0xf3,0x80,0x77,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0x00,0x00};
  const unsigned char PROGMEM icon_reset_11_16[] = {0x00,0x00,0x00,0x00,0x00,0x00,0x19,0xe0,0x21,0xc0,0x41,0xc0,0x81,0x20,0x80,0x20,0x80,0x20,0x80,0x20,0x80,0x20,0x40,0x40,0x20,0x80,0x1f,0x00,0x00,0x00,0x00,0x00};
  const unsigned char PROGMEM icon_left_arrow_3_5 [] = {0x20,0x60,0xe0,0x60,0x20};
  const unsigned char PROGMEM icon_right_arrow_3_5 [] = {0x80,0xc0,0xe0,0xc0,0x80};
  const unsigned char PROGMEM icon_down_arrow_5_3 [] = {0xf8,0x70,0x20};
  const unsigned char PROGMEM icon_up_arrow_5_3 [] = {0x20,0x70,0xf8};
  const unsigned char PROGMEM icon_settings_20_20 [] = {0x00, 0x00, 0x00, 0x00, 0x00, 0x00, 0x00, 0xf0, 0x00, 0x04, 0x92, 0x00, 0x0b,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 0x00, 0x00};
  const unsigned char PROGMEM icon_sleep_mode_20_20[]  = {0x00, 0x00, 0x00, 0x00, 0x00, 0x00, 0x00, 0x00, 0x00, 0x01, 0xc0, 0x00, 0x07,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 0x00, 0x00};
  const unsigned char PROGMEM draw_volumeBorderSeletor_122_18[] = 
  {0x3f, 0xff, 0xff, 0xff, 0xff, 0xff, 0xff, 0xff, 0xff, 0xff, 0xff, 0xff, 0xff,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 0xff, 0x00};
  const unsigned char PROGMEM bg_screenVolumeValue []  = 
  {0x00, 0x00, 0x00, 0x00, 0x00, 0x00, 0x00, 0x00, 0x00, 0x00, 0x00, 0x00, 0x00,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 0x00, 0x00};
  const unsigned char PROGMEM draw_logo_128_64 []  = 
  {0x00, 0x00, 0x00, 0x00, 0x00, 0x00, 0x00, 0x00, 0x00, 0x00, 0x00, 0x00, 0x00,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 0x00, 0x00};

//


void setup() {
  Serial.begin(115200);
  WiFi.mode(WIFI_STA);

  //Inicia Display
  if(!display.begin(SSD1306_SWITCHCAPVCC, 0x3C)){
    Serial.println("SSD1306 allocation failed");
    for(;;); // Don't proceed, loop forever
  }  

  // Configura encoder
  attachInterrupt(digitalPinToInterrupt(CLK), rotaryEncoderCLK, FALLING);
  attachInterrupt(digitalPinToInterrupt(DT), rotaryEncoderDT, FALLING);
  pinMode(CLK, INPUT);
  pinMode(DT, INPUT);
  pinMode(BTN, INPUT);

  //Configura Shift Register
  pinMode(shiftRegisterDataPin, OUTPUT);
  pinMode(shiftRegisterClockPin, OUTPUT);
  pinMode(shiftRegisterSendPin, OUTPUT);

  //TEMP Splash Screen
  segmentDisplayClear();
  display.clearDisplay();
  display.setTextColor(WHITE);
  display.setTextSize(1);
  display.drawBitmap(0, 0, draw_logo_128_64, 128, 64, WHITE);
  display.display();
  delay(2000);
  display.clearDisplay();

  Serial.println("");
  Serial.println("-----------------------");
  Serial.println("--- miniFCU Started ---");
  Serial.println("-----------------------");
  Serial.println("");
  
}

void loop() {
  segmentsDisplayTest();
  segmentDisplayClear();


  // while(!isConnected){
  //   screenChangeWifi();
  // }

  tryConectionWifi();

  shiftOut(shiftRegisterDataPin, shiftRegisterClockPin, LSBFIRST, 0b11110000);
  shiftOut(shiftRegisterDataPin, shiftRegisterClockPin, LSBFIRST, 0b11111101);
  digitalWrite(shiftRegisterSendPin, HIGH);
  digitalWrite(shiftRegisterSendPin, LOW);

  screenMainMenu(0);
  Serial.println("loop end...");
}
